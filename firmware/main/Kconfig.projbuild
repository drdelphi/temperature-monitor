## firmware/main/Kconfig.projbuild
```kconfig
menu "Temperature monitor"

    config LED_RGB_GPIO
        int "WS2812 data GPIO"
        default 48
        range 0 48
        help
            ESP32-S3-DevKitC-1 N16R8 v1.0 onboard RGB is GPIO 48.

    config LED_RGB_BRIGHTNESS
        int "LED brightness (0-255)"
        default 40
        range 1 255

    config LED_RGB_BLINK_MS
        int "Idle RGB on/off period (ms)"
        default 500
        range 50 2000

    config TEMPMON_I2C_SDA_GPIO
        int "DS3231M SDA GPIO"
        default 21
        range 0 48

    config TEMPMON_I2C_SCL_GPIO
        int "DS3231M SCL GPIO"
        default 47
        range 0 48

    config TEMPMON_I2C_FREQ_HZ
        int "I2C frequency"
        default 100000
        range 10000 400000

    config TEMPMON_DS3231_ADDR
        hex "DS3231M I2C address"
        default 0x68

    config TEMPMON_ADC_GPIO_0
        int "NTC channel 0 GPIO"
        default 1
        range 1 10

    config TEMPMON_ADC_GPIO_1
        int "NTC channel 1 GPIO"
        default 2
        range 1 10

    config TEMPMON_ADC_GPIO_2
        int "NTC channel 2 GPIO"
        default 4
        range 1 10

    config TEMPMON_ADC_GPIO_3
        int "NTC channel 3 GPIO"
        default 5
        range 1 10

    config TEMPMON_ADC_GPIO_4
        int "NTC channel 4 GPIO"
        default 6
        range 1 10

    config TEMPMON_ADC_GPIO_5
        int "NTC channel 5 GPIO"
        default 7
        range 1 10

    config TEMPMON_ADC_GPIO_6
        int "NTC channel 6 GPIO"
        default 8
        range 1 10

    config TEMPMON_ADC_GPIO_7
        int "NTC channel 7 GPIO"
        default 9
        range 1 10

    config TEMPMON_ADC_SAMPLES
        int "ADC samples to average"
        default 64
        range 1 256

    config TEMPMON_ADC_TRIM_PCT
        int "Percent of ADC samples to discard from each end before averaging"
        default 25
        range 0 49
        help
            Wi-Fi TX bursts dip the 3V3 rail for a few reads. Dropping the
            highest and lowest 25% leaves 32 of the 64 samples to average,
            which rejects those bursts and still cancels ordinary noise.
            0 restores the plain mean.

    config TEMPMON_ADC_SPREAD_MS
        int "Window to spread one reading's ADC samples over (ms)"
        default 200
        range 0 1000
        help
            Taken back-to-back, all 64 samples land inside one Wi-Fi burst and
            share its rail sag, so averaging and trimming cannot remove it.
            Spreading the rounds over 200 ms makes each reading straddle many
            independent bursts. Must stay well below the shortest channel
            interval. 0 restores back-to-back sampling.

    config TEMPMON_RING_MAX_RECORDS
        int "LittleFS ring max 17-byte records"
        default 655360
        range 1024 800000
        help
            655360 * 17 ≈ 11.1 MB, leaving headroom on the 12.9 MB littlefs partition.
            Unacked records are never overwritten; append fails when the ring is full.

    config TEMPMON_DRAIN_DEFAULT_LIMIT
        int "Default drain/ingest batch size"
        default 32
        range 1 128

    config TEMPMON_INGEST_PERIOD_MS
        int "HTTPS ingest poll period (ms)"
        default 5000
        range 1000 120000

    config TEMPMON_CONFIG_PERIOD_MS
        int "HTTPS config reconcile period (ms)"
        default 60000
        range 5000 600000

    config TEMPMON_WIFI_RETRY_MS
        int "Wi-Fi reconnect delay (ms)"
        default 5000
        range 1000 60000

    config TEMPMON_WIFI_CONNECT_TIMEOUT_MS
        int "Wi-Fi join timeout (ms)"
        default 15000
        range 3000 60000

endmenu
```

## firmware/sdkconfig.defaults
```kconfig
CONFIG_COMPILER_OPTIMIZATION_SIZE=y
CONFIG_NEWLIB_NANO_FORMAT=y
CONFIG_BT_ENABLED=y
CONFIG_BT_NIMBLE_ENABLED=y
CONFIG_BT_NIMBLE_ATT_PREFERRED_MTU=256
CONFIG_BT_NIMBLE_HOST_TASK_STACK_SIZE=4096
CONFIG_BT_NIMBLE_MAX_CONNECTIONS=1
# Peripheral + broadcaster only (NUS advertise / connect).
# CONFIG_BT_NIMBLE_ROLE_CENTRAL is not set
# CONFIG_BT_NIMBLE_ROLE_OBSERVER is not set
# CONFIG_BT_NIMBLE_GATT_CLIENT is not set
# CONFIG_BT_NIMBLE_50_FEATURE_SUPPORT is not set
# STA only — no SoftAP stack.
# CONFIG_ESP_WIFI_SOFTAP_SUPPORT is not set
# CONFIG_LWIP_IPV6 is not set
# Native USB is JSON (usb_serial_jtag driver). Logs stay on UART0 / CP2102.
CONFIG_ESP_CONSOLE_UART_DEFAULT=y
CONFIG_ESP_CONSOLE_UART_BAUDRATE=115200
# CONFIG_ESP_CONSOLE_USB_SERIAL_JTAG is not set
CONFIG_ESP_CONSOLE_SECONDARY_NONE=y
# CONFIG_ESP_CONSOLE_SECONDARY_USB_SERIAL_JTAG is not set
CONFIG_USJ_ENABLE_USB_SERIAL_JTAG=y
CONFIG_ESP_MAIN_TASK_STACK_SIZE=8192
CONFIG_ESP_SYSTEM_EVENT_TASK_STACK_SIZE=4096
CONFIG_FREERTOS_HZ=1000
CONFIG_LED_RGB_GPIO=48
CONFIG_LED_RGB_BRIGHTNESS=40
CONFIG_LED_RGB_BLINK_MS=500
CONFIG_MBEDTLS_CERTIFICATE_BUNDLE=y
# CONFIG_MBEDTLS_CERTIFICATE_BUNDLE_DEFAULT_FULL is not set
CONFIG_MBEDTLS_CERTIFICATE_BUNDLE_DEFAULT_CMN=y
# CONFIG_ESP_TLS_INSECURE is not set
CONFIG_ESP_HTTP_CLIENT_ENABLE_HTTPS=y
# No OTA in this image.
# CONFIG_BOOTLOADER_APP_ROLLBACK_ENABLE is not set
CONFIG_PARTITION_TABLE_CUSTOM=y
CONFIG_PARTITION_TABLE_CUSTOM_FILENAME="partitions.csv"
```
